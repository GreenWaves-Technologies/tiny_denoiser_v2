## Kconfig
```kconfig
# Copyright (c) 2023 GreenWaves Technologies SAS
# All rights reserved.
#
# Redistribution and use in source and binary forms, with or without
# modification, are permitted provided that the following conditions are met:
#
# 1. Redistributions of source code must retain the above copyright notice,
#    this list of conditions and the following disclaimer.
# 2. Redistributions in binary form must reproduce the above copyright
#    notice, this list of conditions and the following disclaimer in the
#    documentation and/or other materials provided with the distribution.
# 3. Neither the name of GreenWaves Technologies SAS nor the names of its
#    contributors may be used to endorse or promote products derived from
#    this software without specific prior written permission.
#
# THIS SOFTWARE IS PROVIDED BY THE COPYRIGHT HOLDERS AND CONTRIBUTORS "AS IS"
# AND ANY EXPRESS OR IMPLIED WARRANTIES, INCLUDING, BUT NOT LIMITED TO, THE
# IMPLIED WARRANTIES OF MERCHANTABILITY AND FITNESS FOR A PARTICULAR PURPOSE
# ARE DISCLAIMED. IN NO EVENT SHALL THE COPYRIGHT OWNER OR CONTRIBUTORS BE
# LIABLE FOR ANY DIRECT, INDIRECT, INCIDENTAL, SPECIAL, EXEMPLARY, OR
# CONSEQUENTIAL DAMAGES (INCLUDING, BUT NOT LIMITED TO, PROCUREMENT OF
# SUBSTITUTE GOODS OR SERVICES; LOSS OF USE, DATA, OR PROFITS; OR BUSINESS
# INTERRUPTION) HOWEVER CAUSED AND ON ANY THEORY OF LIABILITY, WHETHER IN
# CONTRACT, STRICT LIABILITY, OR TORT (INCLUDING NEGLIGENCE OR OTHERWISE)
# ARISING IN ANY WAY OUT OF THE USE OF THIS SOFTWARE, EVEN IF ADVISED OF THE
# POSSIBILITY OF SUCH DAMAGE.

menu "DENOISER APP menu"

    comment "Options"

    choice APP_MODE
        prompt "Application Mode"
        default DEMO

        config DEMO
            select IO_TYPE_UART
            select PLATFORM_BOARD
            bool "Demo Mode"

        config DENOISE_WAV
            bool "DenoiseWav"

    endchoice

    config WAV_FILE_TO_DENOISE
        depends on DENOISE_WAV
        string "Wav to denoise (relative path from dataset/test folder)"
        default "p232_050.wav"

    choice QUANT_TYPE
        prompt "Quantization Type"
        default FP16

        config FP16
            bool "FP16"
            select CNN_SQ8
            select CNN_FP16

        config BFP16
            bool "BFP16"
            select CNN_SQ8
            select CNN_FP16

        config FP16MIXED
            bool "Mixed FP16-INT8"
            select CNN_SQ8
            select CNN_FP16

        config FP16NE16MIXED
            bool "Mixed FP16-INT8 NE16"
            select CNN_SQ8
            select CNN_FP16
            select CNN_NE16

    endchoice

    choice MODEL_TYPE
        prompt  "Select Model"
        default GRU_DNS 

        config GRU_DNS
            bool "GRU trained on DNS (model/denoiser_GRU_dns.onnx)"
        config GRU_VALENTINI
            bool "GRU trained on Valentini (model/denoiser_GRU_Valentini.onnx)"
        config LSTM_VALENTINI
            bool "LSTM trained on Valentini (model/denoiser_LSTM_Valentini.onnx)"
        config NEW_LSTM_DNS_TT_RANK_2
            bool "New LSTM trained on DNS with Tensor Train Rank Reduction to rank 2 (model/tensor_train/tt_denoiser_rank_2.onnx)"
        config NEW_LSTM_DNS_TT_RANK_4
            bool "New LSTM trained on DNS with Tensor Train Rank Reduction to rank 4 (model/tensor_train/tt_denoiser_rank_4.onnx)"
        config NEW_LSTM_DNS_TT_RANK_8
            bool "New LSTM trained on DNS with Tensor Train Rank Reduction to rank 8 (model/tensor_train/tt_denoiser_rank_8.onnx)"
        config NEW_LSTM_DNS_TT_RANK_16
            bool "New LSTM trained on DNS with Tensor Train Rank Reduction to rank 16 (model/tensor_train/tt_denoiser_rank_16.onnx)"
        config NEW_LSTM_DNS_TT_RANK_48
            bool "New LSTM trained on DNS with Tensor Train Rank Reduction to rank 48 (model/tensor_train/tt_denoiser_rank_48.onnx)"
        config NEW_LSTM_DNS_TT_RANK_80
            bool "New LSTM trained on DNS with Tensor Train Rank Reduction to rank 80 (model/tensor_train/tt_denoiser_rank_80.onnx)"
        config NEW_LSTM_DNS_TT_FULL_RANK
            bool "New LSTM trained on DNS with Tensor Train Rank Reduction to rank 80 (model/tensor_train/tt_TinyDenoiser_FullRankLSTM.onnx)"
            
    endchoice

endmenu
source "$(GAP_SDK_HOME)/utils/kconfig/Kconfig"
```
